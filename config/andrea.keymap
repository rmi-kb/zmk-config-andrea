
/*
 * Copyright (c) 2020 The ZMK Contributors
 *
 * SPDX-License-Identifier: MIT
 */


/* THIS FILE WAS GENERATED!
 *
 * This file was generated automatically. You may or may not want to
 * edit it directly.
 */

#include <behaviors.dtsi>
#include <dt-bindings/zmk/keys.h>
#include <dt-bindings/zmk/bt.h>
#include <dt-bindings/zmk/rgb.h>

/ {
    keymap {
        compatible = "zmk,keymap";


        default_layer {
            bindings = <
 &kp ESC  &kp NUM_1  &kp NUM_2  &kp NUM_3  &kp NUM_4  &kp NUM_5            &kp NUM_6  &kp NUM_7  &kp NUM_8  &kp NUM_9  &kp NUM_0  &kp MINUS  &kp EQL  &kp BKSP  &kp DEL  &kp PSCRN  &kp TAB   &kp Q   &kp W   &kp E   &kp R   &kp T   &kp Y   &kp U   &kp I   &kp O   &kp P  &kp LBKT  &kp RBKT  &kp BSLH  &kp PG_UP  &mt LCTRL CAPS   &kp A   &kp S   &kp D   &kp F   &kp G   &kp H   &kp J   &kp K   &kp L  &kp SCLN  &kp QUOT  &kp ENTER  &kp PG_DN  &kp LSHFT   &kp Z   &kp X   &kp C   &kp V   &kp B   &kp B   &kp N   &kp M  &kp CMMA  &kp DOT  &kp FSLH  &kp RSHFT  &kp UP  &kp LCTRL  &kp LALT  &kp SPACE  &lt 1 undefined  &kp SPACE  &kp RALT  &kp LEFT  &kp DOWN  &kp RIGHT
            >;
        };

        layer_fn {
            bindings = <
 &kp GRAVE  &kp F1  &kp F2  &kp F3  &kp F4  &kp F5            &kp F6  &kp F7  &kp F8  &kp F9  &kp F10  &kp F11  &kp F12  &trans  &trans  &kp C_MUTE  &bt BT_CLR  &rgb_ug RGB_TOG  &trans  &rgb_ug RGB_HUI  &rgb_ug RGB_HUD  &bt BT_SEL 1  &kp PSCRN  &kp SLCK  &kp PAUSE_BREAK  &trans  &trans  &trans  &trans  &trans  &kp C_PREV  &trans  &rgb_ug RGB_EFF  &rgb_ug RGB_EFR  &rgb_ug RGB_SAI  &rgb_ug RGB_SAD  &bt BT_SEL 2  &kp INS  &kp HOME  &kp PG_UP  &trans  &trans  &trans  &trans  &kp C_NEXT  &kp LSHFT  &trans  &trans  &rgb_ug RGB_BRI  &rgb_ug RGB_BRD  &bt BT_SEL 3  &trans  &kp DEL  &kp END  &kp PG_DN  &trans  &trans  &trans  &kp PG_UP  &trans  &kp LGUI  &trans  &trans  &trans  &kp C_MENU  &kp HOME  &kp PG_DN  &kp END
            >;
        };

    };
};
